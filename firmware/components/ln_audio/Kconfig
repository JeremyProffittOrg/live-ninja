## firmware/components/ln_audio/Kconfig
```kconfig
menu "Live Ninja audio (ln_audio)"

    config LN_AUDIO_JITTER_PREBUFFER_MS
        int "Playback jitter prebuffer (ms)"
        range 20 500
        default 80
        help
            Milliseconds of downlink audio queued before playback starts.
            Plan M5 calls for a 60-100 ms jitter buffer; 80 ms default.

    config LN_AUDIO_PLAYBACK_RING_MS
        int "Playback ring buffer capacity (ms)"
        range 1000 60000
        default 30000
        help
            Total capacity of the PSRAM playback ring. OpenAI Realtime pushes
            response audio faster than realtime, so this absorbs whole
            responses without blocking the downlink task.

    config LN_AUDIO_DEFAULT_VOLUME
        int "Default speaker volume (0-100)"
        range 0 100
        default 70

    config LN_AUDIO_MIC_GAIN_DB
        int "Analog mic gain (dB)"
        range 0 42
        default 30

    config LN_AUDIO_AEC_REF_DELAY_MS
        int "Software AEC reference delay (ms)"
        range 0 200
        default 24
        help
            Zero-padding inserted ahead of the software echo-reference stream
            each time playback starts, approximating the codec DAC + DMA +
            acoustic latency so the AEC filter sees the reference roughly
            aligned with the echo. The AFE AEC filter tail absorbs the rest.

    config LN_AUDIO_CAPTURE_TASK_PRIORITY
        int "Capture (audio_rx) task priority"
        default 23

    config LN_AUDIO_PLAYBACK_TASK_PRIORITY
        int "Playback task priority"
        default 22

    config LN_AUDIO_TASK_CORE
        int "Core for audio tasks"
        range 0 1
        default 0

endmenu
```

## firmware/components/ln_iot/Kconfig
```kconfig
menu "Live Ninja IoT (ln_iot)"

    config LN_IOT_TOPIC_PREFIX
        string "Application MQTT topic prefix"
        default "liveninja"
        help
            Prefix for application topics: <prefix>/<thingName>/control/up|down and
            <prefix>/<thingName>/telemetry. Must match the per-device IoT policy
            provisioned by the backend (contracts/shadow.md, plan.md M5).

    config LN_IOT_PROV_TEMPLATE
        string "Default fleet provisioning template name"
        default "liveninja-tab5"
        help
            Used when the pairing flow did not store a template name in NVS.
            Must match the Fleet Provisioning template created by WS-A (M0
            "IoT Core baseline").

    config LN_IOT_HEARTBEAT_S
        int "Telemetry heartbeat interval (seconds)"
        default 30
        range 5 3600
        help
            device_heartbeat cadence on liveninja/<thing>/telemetry (rssi, free
            heap, app state, firmware version).

    config LN_IOT_MQTT_BUF_SIZE
        int "MQTT rx/tx buffer size (bytes)"
        default 8192
        range 2048 32768
        help
            Sized so fleet-provisioning responses (certificate PEM ~1.3KB inside
            JSON) and full shadow documents arrive without chunking; chunked
            reassembly is still handled if a payload exceeds this.

    config LN_IOT_VERIFY_TIMEOUT_S
        int "OTA rollback watchdog (seconds)"
        default 300
        range 60 3600
        help
            After booting an unverified (pending-verify) OTA image, the firmware
            must complete an MQTT connect to AWS IoT within this window or it
            calls esp_ota_mark_app_invalid_rollback_and_reboot().

endmenu
```

## firmware/components/ln_net/Kconfig
```kconfig
menu "Live Ninja — network (ln_net)"

    config LN_BACKEND_BASE_URL
        string "Backend base URL"
        default "https://live.jeremy.ninja"
        help
            Base URL of the Live Ninja backend. Device pairing
            (/auth/device/pair/*), token refresh (/auth/refresh) and the
            realtime session mint (/v1/realtime/session) are all resolved
            against this. No trailing slash.

    config LN_PORTAL_AP_SSID
        string "Provisioning SoftAP SSID"
        default "LiveNinja-Setup"
        help
            SSID of the open SoftAP the device raises while unprovisioned
            (PRD M5 screen 1: 'Join Wi-Fi "LiveNinja-Setup"').

    config LN_PORTAL_AP_CHANNEL
        int "Provisioning SoftAP channel"
        range 1 13
        default 6

    config LN_PORTAL_AP_MAX_CLIENTS
        int "Provisioning SoftAP max stations"
        range 1 8
        default 4

    config LN_WIFI_CONNECT_RETRIES
        int "STA connect attempts before falling back to the portal"
        range 1 20
        default 6
        help
            With stored credentials, how many consecutive failed connect
            attempts before the provisioning portal is raised alongside the
            (continuing) background retry loop.

    config LN_WIFI_RETRY_BACKGROUND_S
        int "Background STA retry period while portal is up (seconds)"
        range 10 600
        default 60

    config LN_AUTH_ROTATE_PERIOD_S
        int "Silent refresh-token rotation period (seconds)"
        range 3600 604800
        default 86400
        help
            Steady-state cadence of the silent POST /auth/refresh rotation
            (plan.md M5: 24h). Access JWTs are additionally refreshed
            on demand whenever ln_auth_get_jwt() finds the cached one
            expiring.

endmenu
```

## firmware/components/ln_realtime/Kconfig
```kconfig
menu "Live Ninja realtime client (ln_realtime)"

config LN_RT_BACKEND_BASE_URL
    string "Backend base URL"
    default "https://live.jeremy.ninja"
    help
        Base URL of the Live Ninja backend. The session bootstrap calls
        GET <base>/v1/realtime/session with the device JWT to obtain a
        broker-minted OpenAI ephemeral token (contracts/api.md).

config LN_RT_DEFAULT_MODEL
    string "Fallback OpenAI realtime model"
    default "gpt-realtime"
    help
        Used for the wss://api.openai.com/v1/realtime?model=... query
        parameter only when the broker response does not name a model.

config LN_RT_CLIENT_SEMVER
    string "Client semver for the X-LN-Client header"
    default "0.1.0"
    help
        Semantic version reported as X-LN-Client: m5stack/<semver>+<build>
        (contracts/headers.md). The +<build> part comes from the app
        descriptor version at runtime.

endmenu
```

## firmware/components/ln_wake/Kconfig
```kconfig
menu "Live Ninja wake word (ln_wake)"

    config LN_WAKE_DEFAULT_MODEL
        string "Default WakeNet model name"
        default "wn9_hiesp"
        help
            WakeNet model used when NVS holds no override ("ln_wake"/"model").
            M5-stage built-in model is "Hi, ESP" (wn9_hiesp); the custom
            "Hey Live Ninja" model lands in M6 via the curated set — the
            pipeline is model-agnostic, only this name/NVS changes.

    config LN_WAKE_INPUT_FORMAT
        string "AFE input format string"
        default "MR"
        help
            Channel layout fed to the AFE: M = mic, R = playback (echo)
            reference, N = unused. ln_wake interleaves the primary mic and
            the software echo reference from ln_audio, so "MR" is correct
            for this board. Must contain exactly one M and at most one R.

    config LN_WAKE_FEED_TASK_PRIORITY
        int "AFE feed (ww_feed) task priority"
        default 21

    config LN_WAKE_FETCH_TASK_PRIORITY
        int "AFE fetch/inference (ww_infer) task priority"
        default 20

    config LN_WAKE_TASK_CORE
        int "Core for wake tasks (and AFE internal task)"
        range 0 1
        default 1

endmenu
```

## firmware/sdkconfig.defaults
```kconfig
# Live Ninja Tab5 firmware — sdkconfig defaults (ESP32-P4, 16MB flash, 32MB PSRAM)

CONFIG_IDF_TARGET="esp32p4"

# ---- Flash / partitions ----
CONFIG_ESPTOOLPY_FLASHSIZE_16MB=y
CONFIG_PARTITION_TABLE_CUSTOM=y
CONFIG_PARTITION_TABLE_CUSTOM_FILENAME="partitions_ota.csv"

# ---- PSRAM: Tab5 has 32MB hex-mode PSRAM; 200MHz needs experimental flag ----
CONFIG_SPIRAM=y
CONFIG_SPIRAM_MODE_HEX=y
CONFIG_SPIRAM_SPEED_200M=y
CONFIG_IDF_EXPERIMENTAL_FEATURES=y

# ---- Tab5 BSP recommendations (from esp-bsp display example) ----
CONFIG_ESP32P4_SELECTS_REV_LESS_V3=y
CONFIG_BSP_SPIFFS_PARTITION_LABEL="assets"
CONFIG_CODEC_I2C_BACKWARD_COMPATIBLE=n
CONFIG_CAM_CTRL_SPI_ENABLE=n

# ---- OTA (ln_iot): A/B rollback — new image must MQTT-connect before it is
# marked valid; otherwise the bootloader falls back to the previous slot ----
CONFIG_BOOTLOADER_APP_ROLLBACK_ENABLE=y

# ---- ESP-SR (ln_wake): WakeNet + VADNet models packed to "model" partition ----
CONFIG_MODEL_IN_FLASH=y
CONFIG_AFE_INTERFACE_V1=y
CONFIG_SR_WN_WN9_HIESP=y
CONFIG_SR_VADN_VADNET1_MEDIUM=y
CONFIG_SR_NSN_WEBRTC=y

# ---- FreeRTOS / performance ----
CONFIG_FREERTOS_HZ=1000
CONFIG_COMPILER_OPTIMIZATION_PERF=y
CONFIG_ESP_MAIN_TASK_STACK_SIZE=8192

# ---- C6 radio link: esp-hosted over SDIO (ln_net) ----
# Tab5 wiring: P4 SDIO2 <-> ESP32-C6 module. Pins per M5Stack Tab5 schematic
# (CLK=12 CMD=13 D0=11 D1=10 D2=9 D3=8, C6 reset=15). Confirmed-working
# combination with the factory C6 esp-hosted slave firmware.
CONFIG_ESP_HOSTED_ENABLED=y
CONFIG_ESP_HOSTED_SDIO_HOST_INTERFACE=y
CONFIG_SLAVE_IDF_TARGET_ESP32C6=y
CONFIG_ESP_HOSTED_IDF_SLAVE_TARGET="esp32c6"
CONFIG_ESP_HOSTED_PRIV_SDIO_OPTION=y
CONFIG_ESP_HOSTED_SDIO_PIN_CLK=12
CONFIG_ESP_HOSTED_SDIO_PIN_CMD=13
CONFIG_ESP_HOSTED_SDIO_PIN_D0=11
CONFIG_ESP_HOSTED_SDIO_PRIV_PIN_D1_4BIT_BUS=10
CONFIG_ESP_HOSTED_SDIO_PIN_D1=10
CONFIG_ESP_HOSTED_SDIO_PIN_D2=9
CONFIG_ESP_HOSTED_SDIO_PIN_D3=8
CONFIG_ESP_HOSTED_SDIO_4_BIT_BUS=y
CONFIG_ESP_HOSTED_SDIO_BUS_WIDTH=4
CONFIG_ESP_HOSTED_SDIO_CLOCK_FREQ_KHZ=40000
CONFIG_ESP_HOSTED_SDIO_GPIO_RESET_SLAVE=15
CONFIG_ESP_HOSTED_GPIO_SLAVE_RESET_SLAVE=15
CONFIG_ESP_HOSTED_SDIO_RESET_ACTIVE_LOW=y
CONFIG_ESP_HOSTED_SDIO_OPTIMIZATION_RX_STREAMING_MODE=y

# ---- LVGL 9 (config via Kconfig, lv_conf.h skipped) ----
CONFIG_LV_CONF_SKIP=y
CONFIG_LV_BUILD_EXAMPLES=n
CONFIG_LV_USE_CLIB_MALLOC=y
CONFIG_LV_USE_CLIB_SPRINTF=y
CONFIG_LV_USE_CLIB_STRING=y
CONFIG_LV_FONT_MONTSERRAT_16=y
CONFIG_LV_FONT_MONTSERRAT_18=y
CONFIG_LV_FONT_MONTSERRAT_20=y
CONFIG_LV_FONT_MONTSERRAT_24=y
CONFIG_LV_FONT_MONTSERRAT_28=y
CONFIG_LV_FONT_MONTSERRAT_30=y
CONFIG_LV_FONT_MONTSERRAT_34=y
CONFIG_LV_FONT_MONTSERRAT_36=y
CONFIG_LV_FONT_MONTSERRAT_44=y
CONFIG_LV_FONT_MONTSERRAT_48=y
CONFIG_LV_USE_QRCODE=y

# Internal-RAM discipline: allocations >=8K go PSRAM-first, keep 64K internal
# reserved for task stacks/DMA (httpd + esp-hosted SDIO buffers must not starve).
CONFIG_SPIRAM_MALLOC_ALWAYSINTERNAL=8192
CONFIG_SPIRAM_MALLOC_RESERVE_INTERNAL=65536
CONFIG_BSP_LCD_DRAW_BUF_HEIGHT=25
```
